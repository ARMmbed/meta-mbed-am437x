## conf/layer.conf
```bitbake
# We have a conf and classes directory, add to BBPATH
BBPATH .= ":${LAYERDIR}"

# We have recipes-* directories, add to BBFILES
BBFILES += "${LAYERDIR}/recipes-*/*/*.bb \
	${LAYERDIR}/recipes-*/*/*.bbappend"

BBFILE_COLLECTIONS += "meta-mbed-am437x"
BBFILE_PATTERN_meta-mbed-am437x = "^${LAYERDIR}/"
BBFILE_PRIORITY_meta-mbed-am437x = "10"
LAYERSERIES_COMPAT_meta-mbed-am437x = "rocko"

LICENSE_PATH += "${LAYERDIR}/files/custom-licenses"
```

## conf/machine/mbed-am437x.conf
```bitbake
MACHINE = "am437x-evm"
include conf/machine/am437x-evm.conf

IMAGE_CLASSES += " mbed_sdcard_image-rpi "
IMAGE_FSTYPES_remove = " cpio.xz ubifs ubi"
IMAGE_FSTYPES += " tar.bz2 ext3 mbed-sdimg "
```
